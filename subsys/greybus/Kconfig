## subsys/greybus/Kconfig
```kconfig
# Kconfig - Greybus configuration options
#
# Copyright (c) 2019 Christopher Friedt, <chrisfriedt@gmail.com>
#
# SPDX-License-Identifier: Apache-2.0

menuconfig GREYBUS
	bool "Greybus"
	depends on PTHREAD_DYNAMIC_STACK
	depends on PTHREAD_IPC
	help
	  This option enables Greybus support.

if GREYBUS

choice
	prompt "Greybus Manifest Source"
	default GREYBUS_MANIFEST_BUILTIN

config GREYBUS_MANIFEST_BUILTIN
	bool "Compile the manifest into the application"
	help
	  Choosing this option generates a Greybus Manifest
	  Source file from the unfixed DeviceTree header,
	  converts that into a Greybus Manifest Binary file,
	  and then generates an array in C from the binary
	  data.
endchoice

config GREYBUS_ENABLE_TLS
	bool "Use Transport Layer Security (TLS)"
	depends on TLS_CREDENTIALS
	depends on NET_SOCKETS_SOCKOPT_TLS
	help
	  Choose this option to use industry standard
	  TLS 1.2 authentication and encryption with
	  Greybus.

if GREYBUS_ENABLE_TLS

choice
	prompt "TLS Client Verification"
	default GREYBUS_TLS_CLIENT_VERIFY_NONE

config GREYBUS_TLS_CLIENT_VERIFY_NONE
	bool "No Client Verification"
	help
	  Choose this option so that Greybus never attmpts to verify
	  client credentials.

config GREYBUS_TLS_CLIENT_VERIFY_OPTIONAL
	bool "Optional Client Verification"
	help
	  Choose this option so that Greybus only attmpts to verify
	  client credentials if they provide them.

config GREYBUS_TLS_CLIENT_VERIFY_REQUIRED
	bool "Required Client Verification"
	help
	  Choose this option so that Greybus reuires clients to present
	  verifiable credentials.
endchoice

choice
	prompt "How will TLS credentials be supplied?"
	default GREYBUS_TLS_BUILTIN
	
config GREYBUS_TLS_BUILTIN
	bool "Compile certificates into the application"
	help
	  This option compiles all certificates into the application
	  by converting the specified files into C arrays.
	  
	  It should be noted that this is NOT SECURE.
endchoice

if GREYBUS_TLS_BUILTIN
config GREYBUS_TLS_BUILTIN_CA_CERT
	string "Path to the CA certificate"
	default "${ZEPHYR_BASE}/samples/net/sockets/echo_server/src/ca.der"
	help
	  The path to the Certificate Signing-Authority certificate

config GREYBUS_TLS_BUILTIN_SERVER_CERT
	string "Path to the Greybus server certificate"
	default "${ZEPHYR_BASE}/samples/net/sockets/echo_server/src/server.der"
	help
	  The path to the Greybus Server certificate (public key)

config GREYBUS_TLS_BUILTIN_SERVER_PRIVKEY
	string "Path to the Greybus server private key"
	default "${ZEPHYR_BASE}/samples/net/sockets/echo_server/src/server_privkey.der"
	help
	  The path to the Greybus Server private key

config GREYBUS_TLS_BUILTIN_AUTHORIZED_KEYS
	string "Semicolon-separated paths of authorized public keys"
	default "${ZEPHYR_BASE}/samples/net/sockets/echo_client/src/echo-apps-cert.der"
	help
	  Similar to the way that SSH parses ~/.ssh/authorized_keys,
	  this is a semicolon-separated list of paths to public keys
	  of clients that are authorized to connect to the Greybus
	  Service.
	  
	  Any connections that are initiated for public keys
	  that are not in this list will be terminated immediate
	  following authentication failure.
endif # GREYBUS_TLS_BUILTIN
endif # GREYBUS_ENABLE_TLS

choice
	prompt "Which transport shall be used for Greybus?"
	default GREYBUS_XPORT_TCPIP

config GREYBUS_XPORT_TCPIP
	bool "Use the TCP/IP Transport for Greybus"
	depends on NET_TCP
	depends on NET_SOCKETS
	depends on NET_SOCKETS_POSIX_NAMES
	help
	  This creates a TCP/IP service for Greybus.

config GREYBUS_XPORT_UART
	bool "Use the UART Transport for Greybus"
	depends on SERIAL
	depends on SERIAL_HAS_DRIVER
	help
	  This creates a thread for Greybus on a specific UART.

if GREYBUS_XPORT_UART
config GREYBUS_XPORT_UART_DEV
	string "Run Greybus on which UART?"
	default "UART_1"
	help
	  This setting specifies which UART the Greybus service will use.
endif # GREYBUS_XPORT_UART
endchoice

config GREYBUS_AUDIO
	bool "Greybus Audio"
	help
	  Select this for Greybus Audio support.

config GREYBUS_CAMERA
	bool "Greybus Camera"
	help
	  Select this for Greybus Camera support.

config GREYBUS_CONTROL
	bool "Greybus Control"
	help
	  Select this for a Greybus Control cport.

config GREYBUS_GPIO
	bool "Greybus GPIO"
	help
	  Select this for Greybus GPIO support.

config GREYBUS_HID
	bool "Greybus HID"
	help
	  Select this for Greybus HID support.

config GREYBUS_I2C
	bool "Greybus I2C"
	help
	  Select this for Greybus I2C support.

config GREYBUS_LIGHTS
	bool "Greybus Lights"
	help
	  Select this for Greybus Light support.

config GREYBUS_LOOPBACK
	bool "Greybus Loopback"
	help
	  Select this for Greybus Loopback support.

config GREYBUS_POWER_SUPPLY
	bool "Greybus Power Supply"
	help
	  Select this for Greybus Power Supply support.

config GREYBUS_PWM
	bool "Greybus PWM"
	help
	  Select this for Greybus Pulse Width Modulation support.

config GREYBUS_SDIO
	bool "Greybus SDIO"
	help
	  Select this for Greybus Secure Digital IO support.

config GREYBUS_SPI
	bool "Greybus SPI"
	help
	  Select this for Greybus Serial Peripheral Interface support.

config GREYBUS_UART
	bool "Greybus UART"
	help
	  Select this for Greybus Universal Asynchronous Receiver Transmitter support.

config GREYBUS_USB
	bool "Greybus USB"
	help
	  Select this for Greybus Universal Serial Bus support.

config GREYBUS_VIBRATOR
	bool "Greybus Vibrator"
	help
	  Select this for Greybus Vibrator support.

module = GREYBUS
module-str = Greybus
source "subsys/logging/Kconfig.template.log_config"

endif # GREYBUS
```

## tests/subsys/greybus/gpio/testcase.yaml
```yaml
tests:
  subsys.greybus.gpio:
    tags: greybus
    harness: ztest
  subsys.greybus.gpio.tls:
    tags: greybus tls
    harness: ztest
    extra_configs:
      - CONFIG_GREYBUS_ENABLE_TLS=y
      - CONFIG_GREYBUS_TLS_BUILTIN=y
      - CONFIG_NET_SOCKETS_SOCKOPT_TLS=y
      - CONFIG_TLS_CREDENTIALS=y
```
